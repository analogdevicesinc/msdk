# aes_reva register map
Registers are access not given, no defined reset value unless marked. A register's access mark holds for its fields unless they carry their own. Offsets are from the block's base; lines under a group give offsets from that group; [hi:lo] are bit positions; {n}, {i} and the like mark numbered series; 'fields as' and 'values as' point back to an identical list; <NAME> marks a mode.

## Memory map
0x40005000 AES size 0x400 — AES Keys.

## AES — AES Keys.
Base 0x40005000
0x00 AES_SRAM_KEY 32-bit
0x80 AES_CODE_KEY
0x100 AES_DATA_KEY
