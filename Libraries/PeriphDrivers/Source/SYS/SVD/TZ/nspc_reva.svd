# nspc_reva register map
Registers are access not given, no defined reset value unless marked. A register's access mark holds for its fields unless they carry their own. Offsets are from the block's base; lines under a group give offsets from that group; [hi:lo] are bit positions; {n}, {i} and the like mark numbered series; 'fields as' and 'values as' point back to an identical list; <NAME> marks a mode.

## Memory map
0x40090000 NSPC size 0x1000 — Non-Secure Privilege Controller.

## NSPC — Non-Secure Privilege Controller.
Base 0x40090000
0x160 APBPRIV — APB Tartet Privileged/Non-privileged PPC Access Register.
  [31:0] PERIPH — Each bit configures the APB PPC to enforce the security access allowed for an individual peripheral.
