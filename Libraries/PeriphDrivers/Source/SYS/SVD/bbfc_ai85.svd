# bbfc_ai85 register map
Registers are read-write, no defined reset value unless marked. A register's access mark holds for its fields unless they carry their own. Offsets are from the block's base; lines under a group give offsets from that group; [hi:lo] are bit positions; {n}, {i} and the like mark numbered series; 'fields as' and 'values as' point back to an identical list; <NAME> marks a mode.

## Memory map
0x40005800 BBFC size 0x400 — Battery Backed Function Control Register.

## BBFC — Battery Backed Function Control Register.
Base 0x40005800
0x00 REG0 — Register 0.
  [3:0] AIPWR — AI Power Switch Control.
0x04 REG1 — Register 1.
  [3:0] AIRAMPWR — AI RAM Power Switch Control.
0x08 REG2 — Register 2.
  [3:0] AIISO — AI Power Domain Isolation.
0x0C REG3 — Register 3.
  [3:0] AIRST — AI Power Domain Reset.
