# aeskey_me18 register map
Registers are 128-bit, access not given, no defined reset value unless marked. A register's access mark holds for its fields unless they carry their own. Offsets are from the block's base; lines under a group give offsets from that group; [hi:lo] are bit positions; {n}, {i} and the like mark numbered series; 'fields as' and 'values as' point back to an identical list; <NAME> marks a mode.

## Memory map
0x40005000 AES_KEY size 0x400 — AES Key Registers.

## AES_KEY — AES Key Registers.
Base 0x40005000
0x00 AES_KEY0
0x10 AES_KEY1
0x20 PUF_KEY1 256-bit
0x40 PUF_KEY2 256-bit
