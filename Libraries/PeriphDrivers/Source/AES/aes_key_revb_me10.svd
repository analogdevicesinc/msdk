# aes_key_revb_me10 register map
Registers are 32-bit, access not given, no defined reset value unless marked. A register's access mark holds for its fields unless they carry their own. Offsets are from the block's base; lines under a group give offsets from that group; [hi:lo] are bit positions; {n}, {i} and the like mark numbered series; 'fields as' and 'values as' point back to an identical list; <NAME> marks a mode.

## Memory map
0x40007800 AES_KEY size 0x400 — AES Key Registers.

## AES_KEY — AES Key Registers.
Base 0x40007800
{0x0+4i} AES_KEY0[{i}] (i=0..3)
{0x20+4i} AES_KEY1[{i}] (i=0..3)
{0x100+4i} AES_KEY2[{i}] (i=0..3)
{0x180+4i} AES_KEY3[{i}] (i=0..3)
