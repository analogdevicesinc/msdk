# aes_key_me10 register map
Registers are 32-bit, access not given, no defined reset value unless marked. A register's access mark holds for its fields unless they carry their own. Offsets are from the block's base; lines under a group give offsets from that group; [hi:lo] are bit positions; {n}, {i} and the like mark numbered series; 'fields as' and 'values as' point back to an identical list; <NAME> marks a mode.

## Memory map
0x40005000 AES_KEY size 0x400 — AES Key Registers.

## AES_KEY — AES Key Registers.
Base 0x40005000
{0x0+0x80*i} AES_KEY{i} (i=0..3)
