# gpio_reva_me10 register map
Registers are access not given, no defined reset value unless marked. A register's access mark holds for its fields unless they carry their own. Offsets are from the block's base; lines under a group give offsets from that group; [hi:lo] are bit positions; {n}, {i} and the like mark numbered series; 'fields as' and 'values as' point back to an identical list; <NAME> marks a mode.

## Memory map
0x40008000 GPIO0 size 0x1000 — Individual I/O for each GPIO

## Interrupts
24 GPIO0 — GPIO0 interrupt.

## GPIO0 — Individual I/O for each GPIO
Base 0x40008000
0x00 EN — GPIO Function Enable Register. Each bit controls the GPIO_EN setting for one GPIO pin on the associated port.
  [31:0] GPIO_EN — Mask of all of the pins on the port.
    0=Alternate function enabled; 1=GPIO (GPIO function is enabled.)
0x04 EN_SET — GPIO Set Function Enable Register. Writing a 1 to one or more bits in this register sets the bits in the same positions in GPIO_EN to 1, without affecting other bits in that register.
  [31:0] GPIO_EN_SET — Mask of all of the pins on the port.
    0=no (No effect.); 1=set (Set the corresponding bit in GPIO_EN register.)
0x08 EN_CLR — GPIO Clear Function Enable Register. Writing a 1 to one or more bits in this register clears the bits in the same positions in GPIO_EN to 0, without affecting other bits in that register.
  [31:0] GPIO_EN_CLR — Mask of all of the pins on the port.
    0=no (No effect.); 1=Clear the corresponding bit in GPIO_EN register
0x0C OUT_EN — GPIO Output Enable Register. Each bit controls the GPIO_OUT_EN setting for one GPIO pin in the associated port.
  [31:0] GPIO_OUT_EN — Mask of all of the pins on the port.
    0=dis (GPIO Output Disable); 1=en (GPIO Output Enable)
0x10 OUT_EN_SET — GPIO Output Enable Set Function Enable Register. Writing a 1 to one or more bits in this register sets the bits in the same positions in GPIO_OUT_EN to 1, without affecting other bits in that register.
  [31:0] GPIO_OUT_EN_SET — Mask of all of the pins on the port.
    0=no (No effect.); 1=set (Set the corresponding bit in GPIO_OUT_EN register.)
0x14 OUT_EN_CLR — GPIO Output Enable Clear Function Enable Register. Writing a 1 to one or more bits in this register clears the bits in the same positions in GPIO_OUT_EN to 0, without affecting other bits in that register.
  [31:0] GPIO_OUT_EN_CLR — Mask of all of the pins on the port.
    0=no (No effect.); 1=Clear the corresponding bit in GPIO_OUT_EN register
0x18 OUT — GPIO Output Register. Each bit controls the GPIO_OUT setting for one pin in the associated port. This register can be written either directly, or by using the GPIO_OUT_SET and GPIO_OUT_CLR registers.
  [31:0] GPIO_OUT — Mask of all of the pins on the port.
    0=low (Drive Logic 0 (low) on GPIO output.); 1=high (Drive logic 1 (high) on GPIO output.)
0x1C OUT_SET wo — GPIO Output Set. Writing a 1 to one or more bits in this register sets the bits in the same positions in GPIO_OUT to 1, without affecting other bits in that register.
  [31:0] GPIO_OUT_SET — Mask of all of the pins on the port.
    0=no (No effect.); 1=set (Set the corresponding bit in GPIO_OUT register.)
0x20 OUT_CLR wo — GPIO Output Clear. Writing a 1 to one or more bits in this register clears the bits in the same positions in GPIO_OUT to 0, without affecting other bits in that register.
  [31:0] GPIO_OUT_CLR — Mask of all of the pins on the port.
    0=no (No effect.); 1=Clear the corresponding bit in GPIO_OUT register
0x24 IN ro — GPIO Input Register. Read-only register to read from the logic states of the GPIO pins on this port.
  [31:0] GPIO_IN — Mask of all of the pins on the port.
    0=low (Logic 0 (low) on GPIO input.); 1=high (Logic 1 (high) on GPIO input.)
0x28 INT_MODE — GPIO Interrupt Mode Register. Each bit in this register controls the interrupt mode setting for the associated GPIO pin on this port.
  [31:0] GPIO_INT_MODE — Mask of all of the pins on the port.
    0=level (Interrupts for this pin are level triggered.); 1=edge (Interrupts for this pin are edge triggered.)
0x2C INT_POL — GPIO Interrupt Polarity Register. Each bit in this register controls the interrupt polarity setting for one GPIO pin in the associated port.
  [31:0] GPIO_INT_POL — Mask of all of the pins on the port.
    0=falling (Interrupts are latched on a falling edge or low level condition for this pin.); 1=rising (Interrupts are latched on a rising edge or high condition for this pin.)
0x30 IN_EN — GPIO Port Input Enable.
  [31:0] GPIO_IN_EN — Mask of all of the pins on the port.
    0=dis (GPIO Input Disable); 1=en (GPIO Input Enable)
0x34 INT_EN — GPIO Interrupt Enable Register. Each bit in this register controls the GPIO interrupt enable for the associated pin on the GPIO port.
  [31:0] GPIO_INT_EN — Mask of all of the pins on the port.
    0=dis (Interrupts are disabled for this GPIO pin.); 1=en (Interrupts are enabled for this GPIO pin.)
0x38 INT_EN_SET — GPIO Interrupt Enable Set. Writing a 1 to one or more bits in this register sets the bits in the same positions in GPIO_INT_EN to 1, without affecting other bits in that register.
  [31:0] GPIO_INT_EN_SET — Mask of all of the pins on the port.
    0=no (No Effect.); 1=set (Set GPIO_INT_EN bit in this position to '1')
0x3C INT_EN_CLR — GPIO Interrupt Enable Clear. Writing a 1 to one or more bits in this register clears the bits in the same positions in GPIO_INT_EN to 0, without affecting other bits in that register.
  [31:0] GPIO_INT_EN_CLR — Mask of all of the pins on the port.
    0=no (No Effect.); 1=Clear GPIO_INT_EN bit in this position to '0'
0x40 INT_STAT ro — GPIO Interrupt Status Register. Each bit in this register contains the pending interrupt status for the associated GPIO pin in this port.
  [31:0] GPIO_INT_STAT — Mask of all of the pins on the port.
    0=no (No Interrupt is pending on this GPIO pin.); 1=pending (An Interrupt is pending on this GPIO pin.)
0x48 INT_CLR — GPIO Status Clear. Writing a 1 to one or more bits in this register clears the bits in the same positions in GPIO_INT_STAT to 0, without affecting other bits in that register.
  [31:0] GPIO_INT_CLR — Mask of all of the pins on the port.
    0=no (No effect.); 1=Clear the corresponding bit in GPIO_INT_STAT register
0x4C WAKE_EN — GPIO Wake Enable Register. Each bit in this register controls the PMU wakeup enable for the associated GPIO pin in this port.
  [31:0] GPIO_WAKE_EN — Mask of all of the pins on the port.
    0=dis (PMU wakeup for this GPIO is disabled.); 1=en (PMU wakeup for this GPIO is enabled.)
0x50 WAKE_EN_SET — GPIO Wake Enable Set. Writing a 1 to one or more bits in this register sets the bits in the same positions in GPIO_WAKE_EN to 1, without affecting other bits in that register.
  [31:0] GPIO_WAKE_EN_SET — Mask of all of the pins on the port.
    0=no (No effect.); 1=set (Set the corresponding bit in GPIO_WAKE_EN register.)
0x54 WAKE_EN_CLR — GPIO Wake Enable Clear. Writing a 1 to one or more bits in this register clears the bits in the same positions in GPIO_WAKE_EN to 0, without affecting other bits in that register.
  [31:0] GPIO_WAKE_EN_CLR — Mask of all of the pins on the port.
    0=no (No effect.); 1=Clear the corresponding bit in GPIO_WAKE_EN register
0x5C INT_DUAL_EDGE — GPIO Interrupt Dual Edge Mode Register. Each bit in this register selects dual edge mode for the associated GPIO pin in this port.
  [31:0] GPIO_INT_DUAL_EDGE — Mask of all of the pins on the port.
    0=no (No Effect.); 1=Dual Edge mode is enabled. If edge-triggered interrupts are enabled on this GPIO pin, then both rising and falling edges will trigger interrupts regardless of the GPIO_INT_POL setting.
0x60 PDPU_SEL0 — GPIO Input Mode Config 1. Each bit in this register enables the weak pull-up for the associated GPIO pin in this port.
  [31:0] GPIO_PDPU_SEL0 — The two bits in GPIO_PDPU_SEL0 and GPIO_PDPU_SEL1 for each GPIO pin work together to determine the pad mode when the GPIO is set to input mode.
    0=impedance (High Impedance.); 1=pu (Pull-up mode.)
0x64 PDPU_SEL1 — GPIO Input Mode Config 2. Each bit in this register enables the pull-down for the associated GPIO pin in this port.
  [31:0] GPIO_PDPU_SEL1 — The two bits in GPIO_PDPU_SEL0 and GPIO_PDPU_SEL1 for each GPIO pin work together to determine the pad mode when the GPIO is set to input mode.
    0=impedance (High Impedance.); 1=pd (Pull-down mode.)
0x68 AF_SEL — GPIO Alternate Function Enable Register. Each bit in this register selects between primary/secondary functions for the associated GPIO pin in this port.
  [31:0] GPIO_AF_SEL — Mask of all of the pins on the port.
    0=Primary function selected; 1=Secondary function selected
0x6C AF_SEL_SET — GPIO Alternate Function Selectset. Writing a 1 to one or more bits in this register sets the bits in the same positions in GPIO_EN1 to 1, without affecting other bits in that register.
  [31:0] AF_SEL_SET — Mask of all of the pins on the port.
    0=no (No effect.); 1=set (Set the corresponding bit in GPIO_AF_SEL register.)
0x70 AF_SEL_CLR — GPIO Alternate Function Clear. Writing a 1 to one or more bits in this register clears the bits in the same positions in GPIO_EN1 to 0, without affecting other bits in that register.
  [31:0] GPIO_AF_SEL_CLR — Mask of all of the pins on the port.
    0=no (No effect.); 1=Clear the corresponding bit in GPIO_AF_SEL register
0xB0 DS_SEL0 — GPIO Drive Strength Register. Each bit in this register selects the drive strength for the associated GPIO pin in this port. Refer to the Datasheet for sink/source current of GPIO pins in each mode. The total drive strength multiplier is the multiplication between the two drive strength select registers.
  [31:0] GPIO_DS_SEL0 — Mask of all of the pins on the port.
    0=1 x GPIO_DS_SEL1 = total drive strength multiplier; 1=2X (2 x GPIO_DS_SEL1 = total drive strength multiplier.)
0xB4 DS_SEL1 — GPIO Drive Strength 1 Register. Each bit in this register selects the drive strength for the associated GPIO pin in this port. Refer to the Datasheet for sink/source current of GPIO pins in each mode. The total drive strength multiplier is the multiplication between the two drive strength select registers.
  [31:0] GPIO_DS_SEL1 — Mask of all of the pins on the port.
    0=1 x GPIO_DS_SEL0 = total drive strength multiplier; 1=4X (4 x GPIO_DS_SEL0 = total drive strength multiplier.)
0xB8 PSSEL — GPIO Pull Select Mode.
  [31:0] GPIO_PSSEL — Mask of all of the pins on the port.
    0=WEAK_PDPU (1MOhm Pull-Up/Down resistor connected to the input pin.); 1=STRONG_PDPU (25KOhm Pull-Up/Down resistor connected to the input pin.)
0xC0 VSSEL — GPIO Voltage Select.
  [31:0] GPIO_VSSEL — Mask of all of the pins on the port.
    0=VDDIO (Vddio set as the pin's supply voltage.); 1=VDDIOH (Vddioh set as the pin's supply voltage.)
