# nspc_me30 register map
Registers are access not given, no defined reset value unless marked. A register's access mark holds for its fields unless they carry their own. Offsets are from the block's base; lines under a group give offsets from that group; [hi:lo] are bit positions; {n}, {i} and the like mark numbered series; 'fields as' and 'values as' point back to an identical list; <NAME> marks a mode.

## Memory map
0x40090000 NSPC size 0x1000 — Non-Secure Privilege Controller.

## NSPC — Non-Secure Privilege Controller.
Base 0x40090000
0x160 APBPRIV — APB Tartet Privileged/Non-privileged PPC Access Register.
  [31:0] PERIPH — Each bit configures the APB PPC to enforce the security access allowed for an individual peripheral.
    1=GCR (Privilege setting for GCR.); 2=SIR (Privilege setting for SIR.); 4=FCR (Privilege setting for FCR.); 8=WDT (Privilege setting for WDT.); 16=AES (Privilege setting for AES.); 32=AESKEYS (Privilege setting for AESKEYS.); 64=CRC (Privilege setting for CRC.); 128=GPIO0 (Privilege setting for GPIO0.); 0x100=TMR0 (Privilege setting for TMR0.); 0x200=TMR1 (Privilege setting for TMR1.); 0x400=TMR2 (Privilege setting for TMR2.); 0x800=TMR3 (Privilege setting for TMR3.); 0x1000=TMR4 (Privilege setting for TMR4.); 0x2000=TMR5 (Privilege setting for TMR5.); 0x4000=I3C (Privilege setting for I3C.); 0x8000=UART (Privilege setting for UART.); 0x10000=SPI (Privilege setting for SPI.); 0x20000=TRNG (Privilege setting for TRNG.); 0x40000=BTLE_DBB (Privilege setting for BTLE DBB.); 0x80000=BTLE_RFFE (Privilege setting for BTLE RFFE.); 0x100000=RSTZ (Privilege setting for RSTZ.); 0x200000=BOOST (Privilege setting for Boost Controller.); 0x400000=TRIMSIR (Privilege setting for TRIMSIR.); 0x1000000=RTC (Privilege setting for RTC.); 0x2000000=WUT0 (Privilege setting for WUT0.); 0x4000000=WUT1 (Privilege setting for WUT1.); 0x8000000=PWRSEQ (Privilege setting for Power Sequencer.); 0x10000000=MCR (Privilege setting for MCR.); 0x1F7FFFFF=ALL (Privilege setting for all peripherals.)
0x170 AHBMPRIV — AHB Privileged/Non-Privileged Non-Secure DMA Access Register.
  [1] DMA — Control access for transactions coming from the Non-Secure DMA.
