# boost_reva register map
Registers are read-write, no defined reset value unless marked. A register's access mark holds for its fields unless they carry their own. Offsets are from the block's base; lines under a group give offsets from that group; [hi:lo] are bit positions; {n}, {i} and the like mark numbered series; 'fields as' and 'values as' point back to an identical list; <NAME> marks a mode.

## Memory map
0x40004C00 BOOST size 0x400 — Boost Controller

## Interrupts
46 BOOST

## BOOST — Boost Controller
Base 0x40004C00
0x00 DISABLE 32-bit — Boost Disable Register.
  [0] DIS — This bit allows softwaree to disable the boost regulator for the VDD18 supply.
0x04 VREGCTRL — Boost Voltage Regulator Control Register.
  [4:0] SET — Sets the target voltage for the boost regulator output.
0x08 IPEAK ro — Low Side FET Peak Current Register.
  [2:0] SET — Sets the peak current threshold for the regulator.
0x0C MAXTON ro — Maximum Low Side FET Time-On Register.
  [3:0] THD — Sets a threshold for when time-on out toggles.
0x10 ILOAD ro — Boost Cycle Count Register.
  [7:0] CNT — Indicates the last load cycle count value.
0x14 ALERT — Boost Cycle Count Alert Register.
  [7:0] THD — Determines the threshold for when the boost alert interruptis fired.
0x18 RDY ro — Boost Output Ready Register.
  [0] OUT — Indicates ready out status for boost regulator.
0x1C ZXCAL ro — Zero Cross Calibration Register.
  [4:0] VAL — Read back of auto-calibration values.
0x20 INTEN — Boost Alert Interrupt Enable Register.
  [0] ALERT — Boost alert enable/
0x24 INTFL — Boost Alert Interrupt Status Register.
  [0] ALERT — Boost alert has occurred.
