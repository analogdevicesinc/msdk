# rpu_reva register map
Registers are access not given, no defined reset value unless marked. A register's access mark holds for its fields unless they carry their own. Offsets are from the block's base; lines under a group give offsets from that group; [hi:lo] are bit positions; {n}, {i} and the like mark numbered series; 'fields as' and 'values as' point back to an identical list; <NAME> marks a mode.

## Memory map
0x40002000 RPU size 0x1000 — Resource Protection Unit

## RPU — Resource Protection Unit
Base 0x40002000
0x00 GCR — GCR RPU Register.
  [31:0] ACCESS — APB Slave Peripheral Access Disable.
0x04 SIR — SIR RPU Register.
  [31:0] ACCESS — APB Slave Peripheral Access Disable.
0x08 FCR — FCR RPU Register.
  [31:0] ACCESS — APB Slave Peripheral Access Disable.
0x10 TPU — TPU RPU Register.
  [31:0] ACCESS — APB Slave Peripheral Access Disable.
0x20 RPU
  [31:0] ACCESS — APB Slave Peripheral Access Disable.
{0x30+4i} WDT{i} (i=0..2) — WDT{i} RPU Register.
  [31:0] ACCESS — APB Slave Peripheral Access Disable.
0x40 SMON — SMON RPU Register.
  [31:0] ACCESS — APB Slave Peripheral Access Disable.
0x44 SIMO — SIMO RPU Register.
  [31:0] ACCESS — APB Slave Peripheral Access Disable.
0x48 DVS — DVS RPU Register.
  [31:0] ACCESS — APB Slave Peripheral Access Disable.
0x50 AES — AES RPU Register.
  [31:0] ACCESS — APB Slave Peripheral Access Disable.
0x60 RTC — RTC RPU Register.
  [31:0] ACCESS — APB Slave Peripheral Access Disable.
0x64 WUT — WUT RPU Register.
  [31:0] ACCESS — APB Slave Peripheral Access Disable.
0x68 PWRSEQ — PWRSEQ RPU Register.
  [31:0] ACCESS — APB Slave Peripheral Access Disable.
0x6C MCR — MCR RPU Register.
  [31:0] ACCESS — APB Slave Peripheral Access Disable.
0x80 GPIO0 — GPIO0 RPU Register.
  [31:0] ACCESS — APB Slave Peripheral Access Disable.
0x90 GPIO1 — GPIO1 RPU Register.
  [31:0] ACCESS — APB Slave Peripheral Access Disable.
{0x100+0x10*i} TMR{i} (i=0..5) — TMR{i} RPU Register.
  [31:0] ACCESS — APB Slave Peripheral Access Disable.
0x1B0 HTIMER0 — HTIMER0 RPU Register.
  [31:0] ACCESS — APB Slave Peripheral Access Disable.
0x1C0 HTIMER1 — HTIMER1 RPU Register.
  [31:0] ACCESS — APB Slave Peripheral Access Disable.
{0x1D0+0x10*i} I2C{i}_BUS0 (i=0..2) — I2C{i}_BUS0 RPU Register.
  [31:0] ACCESS — APB Slave Peripheral Access Disable.
0x260 SPIXFM — SPIXFM RPU Register.
  [31:0] ACCESS — APB Slave Peripheral Access Disable.
0x270 SPIXFC — SPIXFC RPU Register.
  [31:0] ACCESS — APB Slave Peripheral Access Disable.
0x280 DMA0 — DMA0 RPU Register.
  [31:0] ACCESS — APB Slave Peripheral Access Disable.
0x290 FLC0 — FLC0 RPU Register.
  [31:0] ACCESS — APB Slave Peripheral Access Disable.
0x294 FLC1 — FLC1 RPU Register.
  [31:0] ACCESS — APB Slave Peripheral Access Disable.
0x2A0 ICC0 — ICC0 RPU Register.
  [31:0] ACCESS — APB Slave Peripheral Access Disable.
0x2A4 ICC1 — ICC1 RPU Register.
  [31:0] ACCESS — APB Slave Peripheral Access Disable.
0x2F0 SFCC — SFCC RPU Register.
  [31:0] ACCESS — APB Slave Peripheral Access Disable.
0x330 SRCC — SRCC RPU Register.
  [31:0] ACCESS — APB Slave Peripheral Access Disable.
0x340 ADC — ADC RPU Register.
  [31:0] ACCESS — APB Slave Peripheral Access Disable.
0x350 DMA1 — DMA1 RPU Register.
  [31:0] ACCESS — APB Slave Peripheral Access Disable.
0x360 SDMA — SDMA RPU Register.
  [31:0] ACCESS — APB Slave Peripheral Access Disable.
0x370 SDHCCTRL — SD Host Controller (APB).
  [31:0] ACCESS — APB Slave Peripheral Access Disable.
0x3A0 SPIXR — SPIXR RPU Register.
  [31:0] ACCESS — APB Slave Peripheral Access Disable.
0x3C0 PTG_BUS0 — PTG_BUS0 RPU Register.
  [31:0] ACCESS — APB Slave Peripheral Access Disable.
0x3D0 OWM — OWM RPU Register.
  [31:0] ACCESS — APB Slave Peripheral Access Disable.
0x3E0 SEMA — SEMA RPU Register.
  [31:0] ACCESS — APB Slave Peripheral Access Disable.
{0x420+0x10*i} UART{i} (i=0..2) — UART{i} RPU Register.
  [31:0] ACCESS — APB Slave Peripheral Access Disable.
0x460 SPI1 — SPI1 RPU Register.
  [31:0] ACCESS — APB Slave Peripheral Access Disable.
0x470 SPI2 — SPI2 RPU Register.
  [31:0] ACCESS — APB Slave Peripheral Access Disable.
0x4C0 AUDIO — AUDIO RPU Register.
  [31:0] ACCESS — APB Slave Peripheral Access Disable.
0x4D0 TRNG — TRNG RPU Register.
  [31:0] ACCESS — APB Slave Peripheral Access Disable.
0x500 BTLE — BTLE RPU Register.
  [31:0] ACCESS — APB Slave Peripheral Access Disable.
0xB10 USBHS — USBHS RPU Register.
  [31:0] ACCESS — APB Slave Peripheral Access Disable.
0xB60 SDIO — SDIO/SDHC Target RPU Register.
  [31:0] ACCESS — APB Slave Peripheral Access Disable.
0xBC0 SPIXFM_FIFO — SPIXFM_FIFO RPU Register.
  [31:0] ACCESS — APB Slave Peripheral Access Disable.
0xBE0 SPI0 — SPI0 RPU Register.
  [31:0] ACCESS — APB Slave Peripheral Access Disable.
{0xF00+0x10*i} SYSRAM{i} (i=0..5) — SYSRAM{i} RPU Register.
  [31:0] ACCESS — APB Slave Peripheral Access Disable.
0xF60 SYSRAM6_11 — SYSRAM6-11 RPU Register.
  [31:0] ACCESS — APB Slave Peripheral Access Disable.
0x11D0 I2C0_BUS1 — I2C0_BUS1 RPU Register.
  [31:0] ACCESS — APB Slave Peripheral Access Disable.
0x11E0 I2C1_BUS1 — I2C1_BUS1 RPU Register.
  [31:0] ACCESS — APB Slave Peripheral Access Disable.
0x11F0 I2C2_BUS1 — I2C2_BU1 RPU Register.
  [31:0] ACCESS — APB Slave Peripheral Access Disable.
0x13C0 PTG_BUS1 — PTG_BUS1 RPU Register.
  [31:0] ACCESS — APB Slave Peripheral Access Disable.
