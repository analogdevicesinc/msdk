# max78002 register map
Vendor: Maxim-Integrated; Series: ARMCM4; File version: 1.1
MAX78002 Machine Learning System-on-Chip, 2.5MB of flash, 384KB of SRAM, 64KB of Boot ROM.
CPU: CM4 r2p1, little endian, MPU, FPU, 3 interrupt priority bits
Registers are 32-bit, read-write, reset 0x0 unless marked. A register's access mark holds for its fields unless they carry their own. Offsets are from the block's base; lines under a group give offsets from that group; [hi:lo] are bit positions; {n}, {i} and the like mark numbered series; 'fields as' and 'values as' point back to an identical list; <NAME> marks a mode.

## Memory map
0x40000000 GCR size 0x400 — Global Control Registers.
0x40000400 SIR size 0x400 — System Initialization Registers.
0x40000800 FCR size 0x400 — Function Control Register.
0x40003000 WDT size 0x400 — Windowed Watchdog Timer
0x40003C00 DVS size 0x30 — Dynamic Voltage Scaling
0x40004400 SIMO size 0x400 — Single Inductor Multiple Output Switching Converter
0x40005400 TRIMSIR size 0x400 — Trim System Initilazation Registers
0x40005800 GCFR size 0x400 — Global Control Function Register.
0x40006000 RTC size 0x400 — Real Time Clock and Alarm.
0x40006400 WUT size 0x400 — Wake Up Timer
0x40006800 PWRSEQ size 0x400 — Power Sequencer / Low Power Control Register.
0x40006C00 MCR size 0x400 — Misc Control.
0x40007400 AES size 0x400 — AES Keys.
0x40007800 AESKEYS size 0x400 — AES Key Registers.
0x40008000 GPIO0 size 0x1000 — Individual I/O for each GPIO
0x40009000 GPIO1 size 0x1000 — Individual I/O for each GPIO 1
0x4000E000 CAMERAIF size 0x1000 — Parallel Camera Interface.
0x4000F000 CRC size 0x1000 — CRC Registers.
0x40010000 TMR size 0x1000 — Low-Power Configurable Timer
0x40011000 TMR1 size 0x1000 — Low-Power Configurable Timer 1
0x40012000 TMR2 size 0x1000 — Low-Power Configurable Timer 2
0x40013000 TMR3 size 0x1000 — Low-Power Configurable Timer 3
0x4001D000 I2C0 size 0x1000 — Inter-Integrated Circuit.
0x4001E000 I2C1 size 0x1000 — Inter-Integrated Circuit. 1
0x4001F000 I2C2 size 0x1000 — Inter-Integrated Circuit. 2
0x40028000 DMA size 0x1000 — DMA Controller Fully programmable, chaining capable DMA channels.
0x40029000 FLC size 0x1000 — Flash Memory Control.
0x4002A000 ICC0 size 0x800 — Instruction Cache Controller Registers
0x4002AC00 ICC1 size 0x800 — Instruction Cache Controller Registers 1
0x40034000 ADC size 0x1000 — Inter-Integrated Circuit.
0x40037000 SDHC size 0x1000 — SDHC/SDIO Controller
0x4003C000 PTG size 0x20 — Pulse Train Generation
0x4003C020 PT size 0x10 — Pulse Train
0x4003C040 PT1 size 0x10 — Pulse Train 1
0x4003C060 PT2 size 0x10 — Pulse Train 2
0x4003C080 PT3 size 0x10 — Pulse Train 3
0x4003D000 OWM size 0x1000 — 1-Wire Master Interface.
0x4003E000 SEMA size 0x1000 — The Semaphore peripheral allows multiple cores in a system to cooperate when accessing shred resources. The peripheral contains eight semaphores that can be atomically set and cleared. It is left to the discretion of the software architect to decide how and when the semaphores are used and how they are allocated. Existing hardware does not have to be modified for this type of cooperative sharing, and the use of semaphores is exclusively within the software domain.
0x40042000 UART size 0x1000 — UART Low Power Registers
0x40043000 UART1 size 0x1000 — UART Low Power Registers 1
0x40044000 UART2 size 0x1000 — UART Low Power Registers 2
0x40046000 SPI1 size 0x1000 — SPI peripheral. 1
0x4004D000 TRNG size 0x1000 — Random Number Generator.
0x40060000 I2S size 0x1000 — Inter-IC Sound Interface.
0x40062000 CSI2 size 0x1000 — Camera Serial Interface Registers.
0x40080000 LPGCR size 0x400 — Low Power Global Control.
0x40080400 GPIO2 size 0x1000 — Individual I/O for each GPIO 2
0x40080800 WDT1 size 0x400 — Windowed Watchdog Timer 1
0x40080C00 TMR4 size 0x1000 — Low-Power Configurable Timer 4
0x40081000 TMR5 size 0x1000 — Low-Power Configurable Timer 5
0x40081400 UART3 size 0x1000 — UART Low Power Registers 3
0x40088000 LPCMP size 0x400 — Low Power Comparator
0x400B1000 USBHS size 0x1000 — USB 2.0 High-speed Controller.
0x400BE000 SPI0 size 0x1000 — SPI peripheral.

## Interrupts
1 WWDT (WDT)
2 USB (USBHS)
3 RTC — RTC interrupt.
4 TRNG — TRNG interrupt.
5 TMR
6 TMR1 — TMR1 IRQ
7 TMR2 — TMR2 IRQ
8 TMR3 — TMR3 IRQ
9 TMR4 — TMR4 IRQ
10 TMR5 — TMR5 IRQ
13 I2C0 — I2C0 IRQ
16 SPI1 — SPI1 IRQ
20 ADC — ADC IRQ
23 Flash_Controller (FLC) — Flash Controller interrupt.
24 GPIO0 — GPIO0 interrupt.
25 GPIO1 — GPIO1 IRQ
26 GPIO2 — GPIO2 IRQ
28 DMA0 (DMA)
29 DMA1 (DMA)
30 DMA2 (DMA)
31 DMA3 (DMA)
36 I2C1 — I2C1 IRQ
53 WUT
56 SPI0
57 WDT1 — WDT1 IRQ
59 PT (PTG) — Pulse Train IRQ
62 I2C2 — I2C2 IRQ
66 SDHC
67 OneWire (OWM)
{n+64} DMA{n} (DMA) (n=4..15)
83 DVS — Dynamic Voltage Scaling Interrupt
91 CameraIF (CAMERAIF)
99 I2S — I2S IRQ
103 LPCMP — Low Power Comparato
