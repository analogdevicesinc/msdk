# max32690 register map
Vendor: Maxim-Integrated; Series: ARMCM4; File version: 1.2
MAX32690 32-bit ARM Cortex-M4F microcontroller, 3.25MB of flash, 1MB of SRAM, 128KB of Boot ROM.
CPU: CM4 r2p1, little endian, MPU, FPU, 3 interrupt priority bits
Registers are 32-bit, read-write, reset 0x0 unless marked. A register's access mark holds for its fields unless they carry their own. Offsets are from the block's base; lines under a group give offsets from that group; [hi:lo] are bit positions; {n}, {i} and the like mark numbered series; 'fields as' and 'values as' point back to an identical list; <NAME> marks a mode.

## Memory map
0x40000000 GCR size 0x400 — Global Control Registers.
0x40000400 SIR size 0x400 — System Initialization Registers.
0x40000800 FCR size 0x400 — Function Control Register.
0x40001000 CTB size 0x1000 — The Cryptographic Toolbox is a combination of cryptographic engines and a secure cryptographic accelerator (SCA) used to provide advanced cryptographic security.
0x40003000 WDT size 0x400 — Windowed Watchdog Timer
0x40004000 SMON size 0x400 — The Security Monitor block used to monitor system threat conditions.
0x40005000 AESKEYS size 0x400 — AES Key Registers.
0x40005400 TRIMSIR size 0x400 — Trim System Initilazation Registers
0x40005800 GCFR size 0x400 — Global Control Function Register.
0x40006000 RTC size 0x400 — Real Time Clock and Alarm.
0x40006400 WUT size 0x400 — Wake Up Timer
0x40006600 WUT1 size 0x400 — Wake Up Timer 1
0x40006800 PWRSEQ size 0x400 — Power Sequencer / Low Power Control Register.
0x40006C00 MCR size 0x400 — Misc Control.
0x40007000 PUF size 0x400 — PUF Registers
0x40008000 GPIO0 size 0x1000 — Individual I/O for each GPIO
0x40009000 GPIO1 size 0x1000 — Individual I/O for each GPIO 1
0x4000A000 GPIO2 size 0x1000 — Individual I/O for each GPIO 2
0x40010000 TMR size 0x1000 — Low-Power Configurable Timer
0x40011000 TMR1 size 0x1000 — Low-Power Configurable Timer 1
0x40012000 TMR2 size 0x1000 — Low-Power Configurable Timer 2
0x40013000 TMR3 size 0x1000 — Low-Power Configurable Timer 3
0x4001D000 I2C0 size 0x1000 — Inter-Integrated Circuit.
0x4001E000 I2C1 size 0x1000 — Inter-Integrated Circuit. 1
0x4001F000 I2C2 size 0x1000 — Inter-Integrated Circuit. 2
0x40026000 SPIXFM size 0x1000 — SPIXF Master
0x40027000 SPIXFC size 0x1000 — SPI XiP Flash Configuration Controller
0x40028000 DMA size 0x1000 — DMA Controller Fully programmable, chaining capable DMA channels.
0x40029000 FLC size 0x400 — Flash Memory Control.
0x40029400 FLC1 size 0x400 — Flash Memory Control 1. Note: WELR2-5 and RLR2-5 are FLC0 only (UG Table 8-3).
0x4002A000 ICC0 size 0x800 — Instruction Cache Controller Registers
0x40033000 EMCC size 0x1000 — External Memory Cache Controller Registers.
0x40034000 ADC size 0x1000 — Inter-Integrated Circuit.
0x40039000 HPB size 0x1000 — HyperBus Memory Controller Registers
0x4003A000 SPIXR size 0x1000 — SPIXR peripheral.
0x4003C000 PTG size 0x20 — Pulse Train Generation
0x4003C020 PT size 0x10 — Pulse Train
{0x4003C020+0x20*n} PT{n} size 0x10 (n=1..15) — Pulse Train {n}
0x4003D000 OWM size 0x1000 — 1-Wire Master Interface.
0x4003E000 SEMA size 0x1000 — The Semaphore peripheral allows multiple cores in a system to cooperate when accessing shred resources. The peripheral contains eight semaphores that can be atomically set and cleared. It is left to the discretion of the software architect to decide how and when the semaphores are used and how they are allocated. Existing hardware does not have to be modified for this type of cooperative sharing, and the use of semaphores is exclusively within the software domain.
0x40042000 UART size 0x1000 — UART Low Power Registers
0x40043000 UART1 size 0x1000 — UART Low Power Registers 1
0x40044000 UART2 size 0x1000 — UART Low Power Registers 2
0x40046000 SPI0 size 0x1000 — SPI peripheral.
0x40047000 SPI1 size 0x1000 — SPI peripheral. 1
0x40048000 SPI2 size 0x1000 — SPI peripheral. 2
0x4004D000 TRNG size 0x1000 — Random Number Generator.
0x40060000 I2S size 0x1000 — Inter-IC Sound Interface.
0x40064000 CAN0 size 0x1000 — Controller Area Network Registers
0x40065000 CAN1 size 0x1000 — Controller Area Network Registers 1
0x40080000 LPGCR size 0x400 — Low Power Global Control.
0x40080400 GPIO3 size 0x1000 — Individual I/O for each GPIO 3
0x40080800 WDT1 size 0x400 — Windowed Watchdog Timer 1
0x40080C00 TMR4 size 0x1000 — Low-Power Configurable Timer 4
0x40081000 TMR5 size 0x1000 — Low-Power Configurable Timer 5
0x40081400 UART3 size 0x1000 — UART Low Power Registers 3
0x40088000 LPCMP size 0x400 — Low Power Comparator
0x400B1000 USBHS size 0x1000 — USB 2.0 High-speed Controller.
0x400BC000 SPIXFC_FIFO size 0x1000 — SPI XiP Master Controller FIFO.
0x400BE000 SPI3 size 0x1000 — SPI peripheral. 3
0x400BE400 SPI4 size 0x1000 — SPI peripheral. 4

## Interrupts
1 WWDT (WDT)
2 USB (USBHS)
3 RTC — RTC interrupt.
4 TRNG — TRNG interrupt.
5 TMR
6 TMR1 — TMR1 IRQ
7 TMR2 — TMR2 IRQ
8 TMR3 — TMR3 IRQ
9 TMR4 — TMR4 IRQ
10 TMR5 — TMR5 IRQ
13 I2C0 — I2C0 IRQ
16 SPI0
17 SPI1 — SPI1 IRQ
18 SPI2 — SPI2 IRQ
20 ADC — ADC IRQ
23 Flash_Controller (FLC) — Flash Controller interrupt.
24 GPIO0 — GPIO0 interrupt.
25 GPIO1 — GPIO1 IRQ
26 GPIO2 — GPIO2 IRQ
27 Crypto_Engine (CTB) — Crypto Engine interrupt.
28 DMA0 (DMA)
29 DMA1 (DMA)
30 DMA2 (DMA)
31 DMA3 (DMA)
36 I2C1 — I2C1 IRQ
38 SPIXFC — SPIXFC IRQ
53 WUT
56 SPI3 — SPI3 IRQ
57 WDT1 — WDT1 IRQ
58 GPIO3 — GPIO3 IRQ
59 PT (PTG) — Pulse Train IRQ
62 I2C2 — I2C2 IRQ
67 OneWire (OWM)
{n+64} DMA{n} (DMA) (n=4..15)
87 Flash_Controller1 (FLC1) — Flash Controller 1 interrupt.
99 I2S — I2S IRQ
103 LPCMP — Low Power Comparato
105 SPI4 — SPI4 IRQ
109 WUT1 — WUT1 IRQ
