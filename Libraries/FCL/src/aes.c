//AES implementation based on
/* Optimised ANSI C code for the Rijndael cipher (now AES)
 *
 * @author Vincent Rijmen <vincent.rijmen@esat.kuleuven.ac.be>
 * @author Antoon Bosselaers <antoon.bosselaers@esat.kuleuven.ac.be>
 * @author Paulo Barreto <paulo.barreto@terra.com.br>
 *
 * This code is hereby placed in the public domain.
 *
 * THIS SOFTWARE IS PROVIDED BY THE AUTHORS ''AS IS'' AND ANY EXPRESS
 * OR IMPLIED WARRANTIES, INCLUDING, BUT NOT LIMITED TO, THE IMPLIED
 * WARRANTIES OF MERCHANTABILITY AND FITNESS FOR A PARTICULAR PURPOSE
 * ARE DISCLAIMED.  IN NO EVENT SHALL THE AUTHORS OR CONTRIBUTORS BE
 * LIABLE FOR ANY DIRECT, INDIRECT, INCIDENTAL, SPECIAL, EXEMPLARY, OR
 * CONSEQUENTIAL DAMAGES (INCLUDING, BUT NOT LIMITED TO, PROCUREMENT OF
 * SUBSTITUTE GOODS OR SERVICES; LOSS OF USE, DATA, OR PROFITS; OR
 * BUSINESS INTERRUPTION) HOWEVER CAUSED AND ON ANY THEORY OF LIABILITY,
 * WHETHER IN CONTRACT, STRICT LIABILITY, OR TORT (INCLUDING NEGLIGENCE
 * OR OTHERWISE) ARISING IN ANY WAY OUT OF THE USE OF THIS SOFTWARE,
 * EVEN IF ADVISED OF THE POSSIBILITY OF SUCH DAMAGE.
 */
#include <ucl/ucl_types.h>
#include <ucl/ucl_retdefs.h>
#include <ucl/ucl_aes.h>

#ifdef SWAP
#define SWAP(x) (_lrotl(x, 8) & 0x00ff00ff | _lrotr(x, 8) & 0xff00ff00)
#define GETU32(p) SWAP(*((u32 *)(p)))
#define PUTU32(ct, st)               \
    {                                \
        *((u32 *)(ct)) = SWAP((st)); \
    }
#else
#define GETU32(pt) \
    (((u32)(pt)[0] << 24) ^ ((u32)(pt)[1] << 16) ^ ((u32)(pt)[2] << 8) ^ ((u32)(pt)[3]))
#define PUTU32(ct, st)              \
    {                               \
        (ct)[0] = (u8)((st) >> 24); \
        (ct)[1] = (u8)((st) >> 16); \
        (ct)[2] = (u8)((st) >> 8);  \
        (ct)[3] = (u8)(st);         \
    }
#endif

static const u32 Te0[256] = {
    0xc66363a5U, 0xf87c7c84U, 0xee777799U, 0xf67b7b8dU, 0xfff2f20dU, 0xd66b6bbdU, 0xde6f6fb1U,
    0x91c5c554U, 0x60303050U, 0x02010103U, 0xce6767a9U, 0x562b2b7dU, 0xe7fefe19U, 0xb5d7d762U,
    0x4dababe6U, 0xec76769aU, 0x8fcaca45U, 0x1f82829dU, 0x89c9c940U, 0xfa7d7d87U, 0xeffafa15U,
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    0x7bb0b0cbU, 0xa85454fcU, 0x6dbbbbd6U, 0x2c16163aU,
};

static const u8 te4[256] = {
    0x63, 0x7c, 0x77, 0x7b, 0xf2, 0x6b, 0x6f, 0xc5, 0x30, 0x01, 0x67, 0x2b, 0xfe, 0xd7, 0xab, 0x76,
    0xca, 0x82, 0xc9, 0x7d, 0xfa, 0x59, 0x47, 0xf0, 0xad, 0xd4, 0xa2, 0xaf, 0x9c, 0xa4, 0x72, 0xc0,
    0xb7, 0xfd, 0x93, 0x26, 0x36, 0x3f, 0xf7, 0xcc, 0x34, 0xa5, 0xe5, 0xf1, 0x71, 0xd8, 0x31, 0x15,
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    0x8c, 0xa1, 0x89, 0x0d, 0xbf, 0xe6, 0x42, 0x68, 0x41, 0x99, 0x2d, 0x0f, 0xb0, 0x54, 0xbb, 0x16
};
static const u32 Td0[256] = {
    0x51f4a750U, 0x7e416553U, 0x1a17a4c3U, 0x3a275e96U, 0x3bab6bcbU, 0x1f9d45f1U, 0xacfa58abU,
    0x4be30393U, 0x2030fa55U, 0xad766df6U, 0x88cc7691U, 0xf5024c25U, 0x4fe5d7fcU, 0xc52acbd7U,
    0x26354480U, 0xb562a38fU, 0xdeb15a49U, 0x25ba1b67U, 0x45ea0e98U, 0x5dfec0e1U, 0xc32f7502U,
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    0x7bcb8461U, 0xd532b670U, 0x486c5c74U, 0xd0b85742U,
};
static const u8 ti4[256] = {
    0x52, 0x09, 0x6a, 0xd5, 0x30, 0x36, 0xa5, 0x38, 0xbf, 0x40, 0xa3, 0x9e, 0x81, 0xf3, 0xd7, 0xfb,
    0x7c, 0xe3, 0x39, 0x82, 0x9b, 0x2f, 0xff, 0x87, 0x34, 0x8e, 0x43, 0x44, 0xc4, 0xde, 0xe9, 0xcb,
    0x54, 0x7b, 0x94, 0x32, 0xa6, 0xc2, 0x23, 0x3d, 0xee, 0x4c, 0x95, 0x0b, 0x42, 0xfa, 0xc3, 0x4e,
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    0x17, 0x2b, 0x04, 0x7e, 0xba, 0x77, 0xd6, 0x26, 0xe1, 0x69, 0x14, 0x63, 0x55, 0x21, 0x0c, 0x7d
};

static const u32 rcon[] = { 0x01000000, 0x02000000, 0x04000000, 0x08000000, 0x10000000,
                            0x20000000, 0x40000000, 0x80000000, 0x1B000000, 0x36000000 };
#define MACRO_ROTR(a, b) ((a) >> ((b)*8) | (a) << (32 - ((b)*8)))
#define MACRO_ROTL(a, b) ((a) << ((b)*8) | (a) >> (32 - ((b)*8)))

int aes_set_ekey(AES_KEY *key, const u8 *userKey, const int len)
{
    u32 *rk;
    int i = 0;
    u32 temp;
    if (!userKey || !key)
        return -1;
    if (len != 16 && len != 24 && len != 32)
        return -2;
    rk = key->rd_key;
    if (len == 16)
        key->rounds = 10;
    else if (len == 24)
        key->rounds = 12;
    else
        key->rounds = 14;
    rk[0] = GETU32(userKey);
    rk[1] = GETU32(userKey + 4);
    rk[2] = GETU32(userKey + 8);
    rk[3] = GETU32(userKey + 12);
    if (len == 16) {
        while (1) {
            temp = rk[3];
            rk[4] = rk[0] ^ ((u32)te4[(temp >> 16) & 0xff] << 24) ^
                    ((u32)te4[(temp >> 8) & 0xff] << 16) ^ ((u32)te4[(temp)&0xff] << 8) ^
                    ((u32)te4[(temp >> 24)]) ^ rcon[i];
            rk[5] = rk[1] ^ rk[4];
            rk[6] = rk[2] ^ rk[5];
            rk[7] = rk[3] ^ rk[6];
            if (++i == 10) {
                return 0;
            }
            rk += 4;
        }
    }
    rk[4] = GETU32(userKey + 16);
    rk[5] = GETU32(userKey + 20);
    if (len == 24) {
        while (1) {
            temp = rk[5];
            rk[6] = rk[0] ^ ((u32)te4[(temp >> 16) & 0xff] << 24) ^
                    ((u32)te4[(temp >> 8) & 0xff] << 16) ^ ((u32)te4[(temp)&0xff] << 8) ^
                    ((u32)te4[(temp >> 24)]) ^ rcon[i];
            rk[7] = rk[1] ^ rk[6];
            rk[8] = rk[2] ^ rk[7];
            rk[9] = rk[3] ^ rk[8];
            if (++i == 8) {
                return 0;
            }
            rk[10] = rk[4] ^ rk[9];
            rk[11] = rk[5] ^ rk[10];
            rk += 6;
        }
    }
    rk[6] = GETU32(userKey + 24);
    rk[7] = GETU32(userKey + 28);
    if (len == 32) {
        while (1) {
            temp = rk[7];
            rk[8] = rk[0] ^ ((u32)te4[(temp >> 16) & 0xff] << 24) ^
                    ((u32)te4[(temp >> 8) & 0xff] << 16) ^ ((u32)te4[(temp)&0xff] << 8) ^
                    ((u32)te4[(temp >> 24)]) ^ rcon[i];
            rk[9] = rk[1] ^ rk[8];
            rk[10] = rk[2] ^ rk[9];
            rk[11] = rk[3] ^ rk[10];
            if (++i == 7) {
                return 0;
            }
            temp = rk[11];
            rk[12] = rk[4] ^ ((u32)te4[(temp >> 24)] << 24) ^
                     ((u32)te4[(temp >> 16) & 0xff] << 16) ^ ((u32)te4[(temp >> 8) & 0xff] << 8) ^
                     ((u32)te4[(temp)&0xff]);
            rk[13] = rk[5] ^ rk[12];
            rk[14] = rk[6] ^ rk[13];
            rk[15] = rk[7] ^ rk[14];
            rk += 8;
        }
    }
    return 0;
}

int aes_set_dkey(AES_KEY *key, const u8 *userKey, const int len)
{
    u32 *rk;
    int i, j, status;
    u32 temp;
    status = aes_set_ekey(key, userKey, len);
    if (status < 0)
        return status;
    rk = key->rd_key;
    for (i = 0, j = 4 * (key->rounds); i < j; i += 4, j -= 4) {
        temp = rk[i];
        rk[i] = rk[j];
        rk[j] = temp;
        temp = rk[i + 1];
        rk[i + 1] = rk[j + 1];
        rk[j + 1] = temp;
        temp = rk[i + 2];
        rk[i + 2] = rk[j + 2];
        rk[j + 2] = temp;
        temp = rk[i + 3];
        rk[i + 3] = rk[j + 3];
        rk[j + 3] = temp;
    }
    for (i = 1; i < (key->rounds); i++) {
        rk += 4;
        rk[0] = Td0[te4[(rk[0] >> 24)]] ^ MACRO_ROTR(Td0[te4[(rk[0] >> 16) & 0xff]], 1) ^
                MACRO_ROTR(Td0[te4[(rk[0] >> 8) & 0xff]], 2) ^
                MACRO_ROTR(Td0[te4[(rk[0]) & 0xff]], 3);
        rk[1] = Td0[te4[(rk[1] >> 24)]] ^ MACRO_ROTR(Td0[te4[(rk[1] >> 16) & 0xff]], 1) ^
                MACRO_ROTR(Td0[te4[(rk[1] >> 8) & 0xff]], 2) ^
                MACRO_ROTR(Td0[te4[(rk[1]) & 0xff]], 3);
        rk[2] = Td0[te4[(rk[2] >> 24)]] ^ MACRO_ROTR(Td0[te4[(rk[2] >> 16) & 0xff]], 1) ^
                MACRO_ROTR(Td0[te4[(rk[2] >> 8) & 0xff]], 2) ^
                MACRO_ROTR(Td0[te4[(rk[2]) & 0xff]], 3);
        rk[3] = Td0[te4[(rk[3] >> 24)]] ^ MACRO_ROTR(Td0[te4[(rk[3] >> 16) & 0xff]], 1) ^
                MACRO_ROTR(Td0[te4[(rk[3] >> 8) & 0xff]], 2) ^
                MACRO_ROTR(Td0[te4[(rk[3]) & 0xff]], 3);
    }

    return 0;
}

int aes_encrypt(u8 *out, const u8 *in, const AES_KEY *key)
{
    const u32 *rk;
    u32 s0, s1, s2, s3, t0, t1, t2, t3;
    int r;
    rk = key->rd_key;
    s0 = GETU32(in) ^ rk[0];
    s1 = GETU32(in + 4) ^ rk[1];
    s2 = GETU32(in + 8) ^ rk[2];
    s3 = GETU32(in + 12) ^ rk[3];
    r = key->rounds >> 1;
    for (;;) {
        t0 = Te0[(s0 >> 24)] ^ MACRO_ROTR(Te0[(s1 >> 16) & 0xff], 1) ^
             MACRO_ROTR(Te0[(s2 >> 8) & 0xff], 2) ^ MACRO_ROTR(Te0[(s3)&0xff], 3) ^ rk[4];
        t1 = Te0[(s1 >> 24)] ^ MACRO_ROTR(Te0[(s2 >> 16) & 0xff], 1) ^
             MACRO_ROTR(Te0[(s3 >> 8) & 0xff], 2) ^ MACRO_ROTR(Te0[(s0)&0xff], 3) ^ rk[5];
        t2 = Te0[(s2 >> 24)] ^ MACRO_ROTR(Te0[(s3 >> 16) & 0xff], 1) ^
             MACRO_ROTR(Te0[(s0 >> 8) & 0xff], 2) ^ MACRO_ROTR(Te0[(s1)&0xff], 3) ^ rk[6];
        t3 = Te0[(s3 >> 24)] ^ MACRO_ROTR(Te0[(s0 >> 16) & 0xff], 1) ^
             MACRO_ROTR(Te0[(s1 >> 8) & 0xff], 2) ^ MACRO_ROTR(Te0[(s2)&0xff], 3) ^ rk[7];
        rk += 8;
        if (--r == 0) {
            break;
        }
        s0 = Te0[(t0 >> 24)] ^ MACRO_ROTR(Te0[(t1 >> 16) & 0xff], 1) ^
             MACRO_ROTR(Te0[(t2 >> 8) & 0xff], 2) ^ MACRO_ROTR(Te0[(t3)&0xff], 3) ^ rk[0];
        s1 = Te0[(t1 >> 24)] ^ MACRO_ROTR(Te0[(t2 >> 16) & 0xff], 1) ^
             MACRO_ROTR(Te0[(t3 >> 8) & 0xff], 2) ^ MACRO_ROTR(Te0[(t0)&0xff], 3) ^ rk[1];
        s2 = Te0[(t2 >> 24)] ^ MACRO_ROTR(Te0[(t3 >> 16) & 0xff], 1) ^
             MACRO_ROTR(Te0[(t0 >> 8) & 0xff], 2) ^ MACRO_ROTR(Te0[(t1)&0xff], 3) ^ rk[2];
        s3 = Te0[(t3 >> 24)] ^ MACRO_ROTR(Te0[(t0 >> 16) & 0xff], 1) ^
             MACRO_ROTR(Te0[(t1 >> 8) & 0xff], 2) ^ MACRO_ROTR(Te0[(t2)&0xff], 3) ^ rk[3];
    }

    s0 = ((u32)te4[(t0 >> 24)] << 24) ^ ((u32)te4[(t1 >> 16) & 0xff] << 16) ^
         ((u32)te4[(t2 >> 8) & 0xff] << 8) ^ ((u32)te4[(t3)&0xff]) ^ rk[0];
    PUTU32(out, s0);
    s1 = ((u32)te4[(t1 >> 24)] << 24) ^ ((u32)te4[(t2 >> 16) & 0xff] << 16) ^
         ((u32)te4[(t3 >> 8) & 0xff] << 8) ^ ((u32)te4[(t0)&0xff]) ^ rk[1];

    PUTU32(out + 4, s1);

    s2 = ((u32)te4[(t2 >> 24)] << 24) ^ ((u32)te4[(t3 >> 16) & 0xff] << 16) ^
         ((u32)te4[(t0 >> 8) & 0xff] << 8) ^ ((u32)te4[(t1)&0xff]) ^ rk[2];

    PUTU32(out + 8, s2);

    s3 = ((u32)te4[(t3 >> 24)] << 24) ^ ((u32)te4[(t0 >> 16) & 0xff] << 16) ^
         ((u32)te4[(t1 >> 8) & 0xff] << 8) ^ ((u32)te4[(t2)&0xff]) ^ rk[3];

    PUTU32(out + 12, s3);
    return (UCL_OK);
}

int aes_decrypt(u8 *out, const u8 *in, const AES_KEY *key)
{
    const u32 *rk;

    u32 s0, s1, s2, s3, t0, t1, t2, t3;

    int r;

    rk = key->rd_key;

    s0 = GETU32(in) ^ rk[0];
    s1 = GETU32(in + 4) ^ rk[1];
    s2 = GETU32(in + 8) ^ rk[2];
    s3 = GETU32(in + 12) ^ rk[3];

    r = key->rounds >> 1;
    for (;;) {
        t0 = Td0[(s0 >> 24)] ^ MACRO_ROTR(Td0[(s3 >> 16) & 0xff], 1) ^
             MACRO_ROTR(Td0[(s2 >> 8) & 0xff], 2) ^ MACRO_ROTR(Td0[(s1)&0xff], 3) ^ rk[4];
        t1 = Td0[(s1 >> 24)] ^ MACRO_ROTR(Td0[(s0 >> 16) & 0xff], 1) ^
             MACRO_ROTR(Td0[(s3 >> 8) & 0xff], 2) ^ MACRO_ROTR(Td0[(s2)&0xff], 3) ^ rk[5];
        t2 = Td0[(s2 >> 24)] ^ MACRO_ROTR(Td0[(s1 >> 16) & 0xff], 1) ^
             MACRO_ROTR(Td0[(s0 >> 8) & 0xff], 2) ^ MACRO_ROTR(Td0[(s3)&0xff], 3) ^ rk[6];
        t3 = Td0[(s3 >> 24)] ^ MACRO_ROTR(Td0[(s2 >> 16) & 0xff], 1) ^
             MACRO_ROTR(Td0[(s1 >> 8) & 0xff], 2) ^ MACRO_ROTR(Td0[(s0)&0xff], 3) ^ rk[7];
        rk += 8;
        if (--r == 0) {
            break;
        }
        s0 = Td0[(t0 >> 24)] ^ MACRO_ROTR(Td0[(t3 >> 16) & 0xff], 1) ^
             MACRO_ROTR(Td0[(t2 >> 8) & 0xff], 2) ^ MACRO_ROTR(Td0[(t1)&0xff], 3) ^ rk[0];
        s1 = Td0[(t1 >> 24)] ^ MACRO_ROTR(Td0[(t0 >> 16) & 0xff], 1) ^
             MACRO_ROTR(Td0[(t3 >> 8) & 0xff], 2) ^ MACRO_ROTR(Td0[(t2)&0xff], 3) ^ rk[1];
        s2 = Td0[(t2 >> 24)] ^ MACRO_ROTR(Td0[(t1 >> 16) & 0xff], 1) ^
             MACRO_ROTR(Td0[(t0 >> 8) & 0xff], 2) ^ MACRO_ROTR(Td0[(t3)&0xff], 3) ^ rk[2];
        s3 = Td0[(t3 >> 24)] ^ MACRO_ROTR(Td0[(t2 >> 16) & 0xff], 1) ^
             MACRO_ROTR(Td0[(t1 >> 8) & 0xff], 2) ^ MACRO_ROTR(Td0[(t0)&0xff], 3) ^ rk[3];
    }

    s0 = ((u32)ti4[(t0 >> 24)] << 24) ^ ((u32)ti4[(t3 >> 16) & 0xff] << 16) ^
         ((u32)ti4[(t2 >> 8) & 0xff] << 8) ^ ((u32)ti4[(t1)&0xff]) ^ rk[0];
    PUTU32(out, s0);
    s1 = ((u32)ti4[(t1 >> 24)] << 24) ^ ((u32)ti4[(t0 >> 16) & 0xff] << 16) ^
         ((u32)ti4[(t3 >> 8) & 0xff] << 8) ^ ((u32)ti4[(t2)&0xff]) ^ rk[1];
    PUTU32(out + 4, s1);
    s2 = ((u32)ti4[(t2 >> 24)] << 24) ^ ((u32)ti4[(t1 >> 16) & 0xff] << 16) ^
         ((u32)ti4[(t0 >> 8) & 0xff] << 8) ^ ((u32)ti4[(t3)&0xff]) ^ rk[2];
    PUTU32(out + 8, s2);
    s3 = ((u32)ti4[(t3 >> 24)] << 24) ^ ((u32)ti4[(t2 >> 16) & 0xff] << 16) ^
         ((u32)ti4[(t1 >> 8) & 0xff] << 8) ^ ((u32)ti4[(t0)&0xff]) ^ rk[3];
    PUTU32(out + 12, s3);
    return (UCL_OK);
}
